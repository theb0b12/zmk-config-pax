#include "pax.dtsi"

/ {
    kscan0: kscan0 {
        compatible = "zmk,kscan-gpio-direct";
        wakeup-source;

        input-gpios
            = <&pro_micro 9 (GPIO_ACTIVE_LOW | GPIO_PULL_UP)>
            , <&pro_micro 8 (GPIO_ACTIVE_LOW | GPIO_PULL_UP)>
            , <&pro_micro 7 (GPIO_ACTIVE_LOW | GPIO_PULL_UP)>
            , <&pro_micro 6 (GPIO_ACTIVE_LOW | GPIO_PULL_UP)>
            , <&pro_micro 4 (GPIO_ACTIVE_LOW | GPIO_PULL_UP)>
            , <&pro_micro 5 (GPIO_ACTIVE_LOW | GPIO_PULL_UP)>
            , <&pro_micro 2 (GPIO_ACTIVE_LOW | GPIO_PULL_UP)>
            , <&pro_micro 3 (GPIO_ACTIVE_LOW | GPIO_PULL_UP)>
            , <&pro_micro 1 (GPIO_ACTIVE_LOW | GPIO_PULL_UP)>
            , <&pro_micro 0 (GPIO_ACTIVE_LOW | GPIO_PULL_UP)>
            ;
    };
};

&physical_layout_pax {
    kscan = <&kscan0>;
};

